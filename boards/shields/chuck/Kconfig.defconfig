## boards/shields/chuck/Kconfig.defconfig
```kconfig
if SHIELD_CHARLIEFLEX_DONGLE || SHIELD_CHARLIEFLEX_UNIBODY

config ZMK_KEYBOARD_NAME
    default "Charlieflex"

config ZMK_USB
    default y

endif

if SHIELD_CHARLIEFLEX_DONGLE

config ZMK_SPLIT_ROLE_CENTRAL
    default y

config ZMK_SPLIT_BLE_CENTRAL_BATTERY_LEVEL_FETCHING
    default y

config ZMK_SPLIT_BLE_CENTRAL_PERIPHERALS
    default 1

config BT_MAX_CONN
    default 6

config BT_MAX_PAIRED
    default 6

config ZMK_DISPLAY
    default y

config ZMK_IDLE_TIMEOUT
    default 300000

config BT_BAS
    default n

endif

if SHIELD_CHARLIEFLEX_UNIBODY

config BT_MAX_CONN
    default 5

config BT_MAX_PAIRED
    default 5

endif

if SHIELD_CHARLIEFLEX_DONGLE || SHIELD_CHARLIEFLEX_PERIPHERAL

config ZMK_SPLIT
    default y

config ZMK_BLE
    default y

endif
```

## boards/shields/chuck/Kconfig.shield
```kconfig
config SHIELD_CHARLIEFLEX_UNIBODY
    def_bool $(shields_list_contains,charlieflex_unibody)

config SHIELD_CHARLIEFLEX_DONGLE
    def_bool $(shields_list_contains,charlieflex_dongle)

config SHIELD_CHARLIEFLEX_PERIPHERAL
    def_bool $(shields_list_contains,charlieflex_peripheral)
```

## config/west.yml
```yaml
manifest:
  remotes:
    - name: zmkfirmware
      url-base: https://github.com/zmkfirmware
    - name: caksoylar
      url-base: https://github.com/caksoylar
    - name: carrefinho
      url-base: https://github.com/carrefinho
  projects:
    - name: zmk
      remote: zmkfirmware
      revision: main
      import: app/west.yml
    - name: zmk-rgbled-widget
      remote: caksoylar
      revision: main
    - name: prospector-zmk-module
      remote: carrefinho
      revision: main
  self:
    path: config
```
