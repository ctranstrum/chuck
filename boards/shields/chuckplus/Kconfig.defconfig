## boards/shields/chuckplus/Kconfig.defconfig
```kconfig
if SHIELD_CHUCKPLUS_DONGLE || SHIELD_CHUCKPLUS_UNIBODY

config ZMK_KEYBOARD_NAME
    default "ChuckPlus"

config ZMK_USB
    default y

endif

if SHIELD_CHUCKPLUS_DONGLE

config ZMK_SPLIT_ROLE_CENTRAL
    default y

config ZMK_SPLIT_BLE_CENTRAL_BATTERY_LEVEL_FETCHING
    default y

config ZMK_SPLIT_BLE_CENTRAL_PERIPHERALS
    default 1

config BT_MAX_CONN
    default 6

config BT_MAX_PAIRED
    default 6

config ZMK_DISPLAY
    default y

config ZMK_IDLE_TIMEOUT
    default 300000

config BT_BAS
    default n

endif

if SHIELD_CHUCKPLUS_UNIBODY

config BT_MAX_CONN
    default 5

config BT_MAX_PAIRED
    default 5

endif

if SHIELD_CHUCKPLUS_DONGLE || SHIELD_CHUCKPLUS_PERIPHERAL

config ZMK_SPLIT
    default y

config ZMK_BLE
    default y

endif
```

## boards/shields/chuckplus/Kconfig.shield
```kconfig
config SHIELD_CHUCKPLUS_UNIBODY
    def_bool $(shields_list_contains,chuckplus_unibody)

config SHIELD_CHUCKPLUS_DONGLE
    def_bool $(shields_list_contains,chuckplus_dongle)

config SHIELD_CHUCKPLUS_PERIPHERAL
    def_bool $(shields_list_contains,chuckplus_peripheral)
```
